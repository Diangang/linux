## mm/Kconfig
```kconfig
# SPDX-License-Identifier: GPL-2.0-only

menu "Memory Management options"

menu "Slab allocator options"

config SLUB
	def_bool y
	select IRQ_WORK

config KVFREE_RCU_BATCHED
	def_bool y

config SLAB_MERGE_DEFAULT
	bool "Allow slab caches to be merged"
	default y
	help
	  For reduced kernel memory fragmentation, slab caches can be
	  merged when they share the same size and other characteristics.
	  This carries a risk of kernel heap overflows being able to
	  overwrite objects from merged caches (and more easily control
	  cache layout), which makes such heap attacks easier to exploit
	  by attackers. By keeping caches unmerged, these kinds of exploits
	  can usually only damage objects in the same cache. To disable
	  merging at runtime, "slab_nomerge" can be passed on the kernel
	  command line.

endmenu # Slab allocator options

config SPARSEMEM
	def_bool y
	depends on ARCH_SPARSEMEM_ENABLE

config SPARSEMEM_EXTREME
	def_bool y
	depends on SPARSEMEM

config SPARSEMEM_VMEMMAP_ENABLE
	bool

config SPARSEMEM_VMEMMAP
	def_bool y
	depends on SPARSEMEM && SPARSEMEM_VMEMMAP_ENABLE
	help
	  SPARSEMEM_VMEMMAP uses a virtually mapped memmap to optimise
	  pfn_to_page and page_to_pfn operations.  This is the most
	  efficient option when sufficient kernel resources are available.

config ARCH_WANT_OPTIMIZE_DAX_VMEMMAP
	bool

config ARCH_WANT_OPTIMIZE_HUGETLB_VMEMMAP
	bool

config ARCH_WANT_HUGETLB_VMEMMAP_PREINIT
	bool

config HAVE_GUP_FAST
	depends on MMU
	bool

# Enable memblock support for scratch memory which is needed for kexec handover
config ARCH_KEEP_MEMBLOCK
	bool

# Heavily threaded applications may benefit from splitting the mm-wide
# page_table_lock, so that faults on different parts of the user address
# space can be handled with less contention: split it at this NR_CPUS.
# Default to 4 for wider testing, though 8 might be more appropriate.
# ARM's adjust_pte (unused if VIPT) depends on mm-wide page_table_lock.
# PA-RISC 7xxx's spinlock_t would enlarge struct page from 32 to 44 bytes.
# SPARC32 allocates multiple pte tables within a single page, and therefore
# a per-page lock leads to problems when multiple tables need to be locked
# at the same time (e.g. copy_page_range()).
# DEBUG_SPINLOCK and DEBUG_LOCK_ALLOC spinlock_t also enlarge struct page.
#
config SPLIT_PTE_PTLOCKS
	def_bool y
	depends on MMU
	depends on SMP
	depends on NR_CPUS >= 4

config ARCH_ENABLE_SPLIT_PMD_PTLOCK
	bool

config SPLIT_PMD_PTLOCKS
	def_bool y
	depends on SPLIT_PTE_PTLOCKS && ARCH_ENABLE_SPLIT_PMD_PTLOCK

#
# support for memory balloon
#
# support for memory compaction
config COMPACTION
	bool "Allow for memory compaction"
	default y
	select MIGRATION
	depends on MMU
	help
	  Compaction is the only memory management component to form
	  high order (larger physically contiguous) memory blocks
	  reliably. The page allocator relies on compaction heavily and
	  the lack of the feature can lead to unexpected OOM killer
	  invocations for high order memory requests. You shouldn't
	  disable this option unless there really is a strong reason for
	  it and then we would be really interested to hear about that at
	  linux-mm@kvack.org.

config COMPACT_UNEVICTABLE_DEFAULT
	int
	depends on COMPACTION
	default 1

config NUMA_MIGRATION
	bool "NUMA page migration"
	default y
	depends on NUMA && MMU
	select MIGRATION
	help
	  Support the migration of pages to other NUMA nodes, available to
	  user space through interfaces like migrate_pages(), move_pages(),
	  and mbind(). Selecting this option also enables support for page
	  demotion for memory tiering.

config MIGRATION
	bool
	depends on MMU

config PCP_BATCH_SCALE_MAX
	int "Maximum scale factor of PCP (Per-CPU pageset) batch allocate/free"
	default 5
	range 0 6
	help
	  In page allocator, PCP (Per-CPU pageset) is refilled and drained in
	  batches.  The batch number is scaled automatically to improve page
	  allocation/free throughput.  But too large scale factor may hurt
	  latency.  This option sets the upper limit of scale factor to limit
	  the maximum latency.

config PHYS_ADDR_T_64BIT
	def_bool 64BIT

config DEFAULT_MMAP_MIN_ADDR
	int "Low address space to protect from user allocation"
	depends on MMU
	default 4096
	help
	  This is the portion of low virtual memory which should be protected
	  from userspace allocation.  Keeping a user from writing to low pages
	  can help reduce the impact of kernel NULL pointer bugs.

	  For most arm64, ppc64 and x86 users with lots of address space
	  a value of 65536 is reasonable and should cause no problems.
	  On arm and other archs it should not be higher than 32768.
	  Programs which use vm86 functionality or have some need to map
	  this low address space will need CAP_SYS_RAWIO or disable this
	  protection by setting the value to 0.

	  This value can be changed after boot using the
	  /proc/sys/vm/mmap_min_addr tunable.

config ARCH_SUPPORTS_MEMORY_FAILURE
	bool

config MEMORY_FAILURE
	depends on MMU
	depends on ARCH_SUPPORTS_MEMORY_FAILURE
	bool "Enable recovery from hardware memory errors"
	select INTERVAL_TREE
	help
	  Enables code to recover from some memory failures on systems
	  with MCA recovery. This allows a system to continue running
	  even when some of its memory has uncorrected errors. This requires
	  special hardware support and typically ECC memory.

config ARCH_WANT_GENERAL_HUGETLB
	bool

# simple helper to make the code a bit easier to read
config PAGE_MAPCOUNT
	def_bool y

config NEED_PER_CPU_EMBED_FIRST_CHUNK
	bool

config NEED_PER_CPU_PAGE_FIRST_CHUNK
	bool

config USE_PERCPU_NUMA_NODE_ID
	bool

config HAVE_SETUP_PER_CPU_AREA
	bool

config ARCH_FORCE_MAX_ORDER
	int

#
# When ARCH_FORCE_MAX_ORDER is not defined,
# the default page block order is MAX_PAGE_ORDER (10) as per
# include/linux/mmzone.h.
#
config PAGE_BLOCK_MAX_ORDER
	int "Page Block Order Upper Limit"
	range 1 10 if ARCH_FORCE_MAX_ORDER = 0
	default 10 if ARCH_FORCE_MAX_ORDER = 0
	range 1 ARCH_FORCE_MAX_ORDER if ARCH_FORCE_MAX_ORDER != 0
	default ARCH_FORCE_MAX_ORDER if ARCH_FORCE_MAX_ORDER != 0
	help
	  The page block order refers to the power of two number of pages that
	  are physically contiguous and can have a migrate type associated to
	  them. The maximum size of the page block order is at least limited by
	  ARCH_FORCE_MAX_ORDER/MAX_PAGE_ORDER.

	  This config adds a new upper limit of default page block
	  order when the page block order is required to be smaller than
	  ARCH_FORCE_MAX_ORDER/MAX_PAGE_ORDER or other limits
	  (see include/linux/pageblock-flags.h for details).

	  Reducing pageblock order can negatively impact THP generation
	  success rate. If your workloads use THP heavily, please use this
	  option with caution.

	  Don't change if unsure.

config GENERIC_EARLY_IOREMAP
	bool

config ARCH_HAS_CACHE_LINE_SIZE
	bool

config ZONE_DMA
	bool "Support DMA zone"
	default y if ARM64 || X86

config ZONE_DMA32
	bool "Support DMA32 zone"
	default y if ARM64

config ARCH_USES_HIGH_VMA_FLAGS
	bool
config ARCH_HAS_PKEYS
	bool

config ARCH_USES_PG_ARCH_2
	bool

config VM_EVENT_COUNTERS
	default y
	bool "Enable VM event counters for /proc/vmstat" if EXPERT
	help
	  VM event counters are needed for event counts to be shown.
	  This option allows the disabling of the VM event counters
	  on EXPERT systems.  /proc/vmstat will only show page counts
	  if VM event counters are disabled.

config ARCH_HAS_PTE_SPECIAL
	bool

# multi-gen LRU {

config ARCH_SUPPORTS_PER_VMA_LOCK
       def_bool n

config PER_VMA_LOCK
	def_bool y
	depends on ARCH_SUPPORTS_PER_VMA_LOCK && MMU && SMP
	help
	  Allow per-vma locking during page fault handling.

	  This feature allows locking each virtual memory area separately when
	  handling page faults instead of taking mmap_lock.

config LOCK_MM_AND_FIND_VMA
	bool

config EXECMEM
	bool

config NUMA_MEMBLKS
	bool

config ARCH_HAS_USER_SHADOW_STACK
	bool
	help
	  The architecture has hardware support for userspace shadow call
          stacks (eg, x86 CET, arm64 GCS or RISC-V Zicfiss).

config PT_RECLAIM
	def_bool y
	depends on MMU_GATHER_RCU_TABLE_FREE && !n
	help
	  Try to reclaim empty user page table pages in paths other than munmap
	  and exit_mmap path.

	  Note: now only empty user PTE page table pages will be reclaimed.

config ARCH_HAS_LAZY_MMU_MODE
	bool
	help
	  The architecture uses the lazy MMU mode. This allows changes to
	  MMU-related architectural state to be deferred until the mode is
	  exited. See <linux/pgtable.h> for details.

endmenu
```

## mm/Kconfig.debug
```kconfig
# SPDX-License-Identifier: GPL-2.0-only
config SLUB_DEBUG
	default y
	bool "Enable SLUB debugging support" if EXPERT
	depends on SYSFS
	select STACKDEPOT if STACKTRACE_SUPPORT
	help
	  SLUB has extensive debug support features. Disabling these can
	  result in significant savings in code size. While /sys/kernel/slab
	  will still exist (with SYSFS enabled), it will not provide e.g. cache
	  validation.

config ARCH_HAS_DEBUG_WX
	bool

config ARCH_HAS_PTDUMP
	bool

config PTDUMP
	bool

config HAVE_DEBUG_KMEMLEAK
	bool
```

## usr/Kconfig
```kconfig
# SPDX-License-Identifier: GPL-2.0
#
# Configuration for initramfs
#

config INITRAMFS_SOURCE
	string "Initramfs source file(s)"
	default ""
	help
	  This can be either a single cpio archive with a .cpio suffix or a
	  space-separated list of directories and files for building the
	  initramfs image.  A cpio archive should contain a filesystem archive
	  to be used as an initramfs image.  Directories should contain a
	  filesystem layout to be included in the initramfs image.  Files
	  should contain entries according to the format described by the
	  "usr/gen_init_cpio" program in the kernel tree.

	  When multiple directories and files are specified then the
	  initramfs image will be the aggregate of all of them.

	  See <file:Documentation/driver-api/early-userspace/early_userspace_support.rst> for more details.

	  If you are not sure, leave it blank.
```
